## src/modules/marine_navigation/Kconfig
```kconfig
menuconfig MODULES_MARINE_NAVIGATION
	bool "marine_navigation"
	default n
	---help---
		Enable support for marine_navigation
```

## src/modules/marine_takeoff/Kconfig
```kconfig
menuconfig MODULES_MARINE_TAKEOFF
	bool "marine_takeoff"
	default n
	---help---
		Enable support for marine_takeoff
```
